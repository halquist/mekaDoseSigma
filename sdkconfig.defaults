## sdkconfig.defaults
```kconfig
# Target: ESP32-S3
CONFIG_IDF_TARGET="esp32s3"

# Flash and PSRAM configuration for XIAO ESP32-S3
CONFIG_ESPTOOLPY_FLASHSIZE_8MB=y
CONFIG_ESPTOOLPY_FLASHMODE_QIO=y
CONFIG_SPIRAM=y
CONFIG_SPIRAM_MODE_OCT=y
CONFIG_SPIRAM_SPEED_80M=y

# CPU frequency
CONFIG_ESP_DEFAULT_CPU_FREQ_MHZ_240=y

# Enable C++ exceptions (Jet may need this)
CONFIG_COMPILER_CXX_EXCEPTIONS=y

# Optimize for performance
CONFIG_COMPILER_OPTIMIZATION_PERF=y

# FreeRTOS tick rate
CONFIG_FREERTOS_HZ=1000

# Increase main task stack size for Jet
CONFIG_ESP_MAIN_TASK_STACK_SIZE=8192

# SPI configuration
CONFIG_SPI_MASTER_ISR_IN_IRAM=y

# Log level
CONFIG_LOG_DEFAULT_LEVEL_INFO=y
```
